/dts-v1/;
/include/ "system-conf.dtsi"
/ {
};

&gem0 {
	phy-handle = <&phy0>;
		mdio {
		#address-cells = <1>;
		#size-cells = <0>;
		phy0: phy@0 {
		compatible = "marvell,88e1510";
		device_type = "ethernet-phy";
		reg = <0>;
		};
	};
};

