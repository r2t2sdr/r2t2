## linux/trunk/linux-3.17/drivers/net/r2t2/Kconfig
```kconfig
config R2T2 
	tristate "R2T2 support"
	---help---
	  Add support for DB1CC/DL2STG R2T2 device
```

## linux/trunk/linux-3.17/drivers/net/radium/Kconfig
```kconfig
config NET_RADIUM
	tristate "Radium network fpga driver"
	---help---
	  This option enables the Radium network driver for communication with fpga
```

## linux/trunk/linux-4.0-adi/boot.its
```
/*
 * Simple U-boot uImage source file containing a single kernel and FDT blob
 */
/dts-v1/;
/ {
	description = "R2T2 arm uImage with single Linux kernel and FDT blob";
	#address-cells = <1>;

	images {
		kernel@1 {
			description = "R2T2 Kernel";
			data = /incbin/("./vmlinux.bin");
			type = "kernel";
			arch = "arm";
			os = "linux";
			compression = "none";
			load = <0x02008000>;
			entry = <0x02008000>;
			hash@1 {
				algo = "crc32";
			};
		};
		/* @@ramdisk_node@@
		ramdisk@1 {
			description = "ramdisk";
			data = /incbin/("./");
			type = "ramdisk";
			arch = "arm";
			os = "linux";
			load = <0x0>;
			compression = "none";
			hash@1 {
				algo = "crc32";
			};
			hash@2 {
				algo = "sha1";
			};
		};
	@@ramdisk_node@@ */
		fdt@1 {
			description = "Flattened Device Tree blob";
			data = /incbin/("./devicetree.dtb");
			type = "flat_dt";
			arch = "arm";
			compression = "none";
			hash@1 {
				algo = "crc32";
			};
		};
	};

	configurations {
		default = "conf@1";
		conf@1 {
			description = "R2T2 Boot Linux kernel with FDT blob";
			kernel = "kernel@1";
			/* @@ramdisk_node@@
			ramdisk = "ramdisk@1";
			@@ramdisk_node@@ */
			fdt = "fdt@1";
		};
	};
};
```

## linux/trunk/linux-4.0-adi/drivers/net/r2t2/Kconfig
```kconfig
config NET_R2T2
	tristate "R2T2 network fpga driver"
	---help---
	  This option enables the R2T2 network driver for communication with fpga
```
