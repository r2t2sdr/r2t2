
&gem0 {
	phy-handle = <&phy0>;
	phy-mode = "rgmii-id";


		 phy0: phy@0 {
		  compatible = "marvell,88e1510";
		  device_type = "ethernet-phy";
		  reg = <0x0>;
		  marvell,reg-init=<3 16 0xff00 0x1e 3 17 0xfff0 0x0a>;
	  };
};

